## fs/ext4_tiny4412/Config.in
```kconfig
config BR2_TARGET_ROOTFS_EXT4_TINY4412
	bool "ext4 specify for tiny 4412"
	select BR2_PACKAGE_HOST_E2FSPROGS
	help
	  Build an eext4 root filesystem for tiny4412 only

if BR2_TARGET_ROOTFS_EXT4_TINY4412

config BR2_TARGET_ROOTFS_EXT4_TINY4412_LABEL
	string "filesystem label"

config BR2_TARGET_ROOTFS_EXT4_TINY4412_SIZE
	string "fs image size"
	default "314572800"
	help
	  The size of the filesystem image. If it does not have a suffix,
	  it is interpreted as power-of-two kilobytes. If it is suffixed
	  by 'k', 'm', 'g', 't' (either upper-case or lower-case), then
	  it is interpreted in power-of-two kilobytes, megabytes,
	  gigabytes, terabytes, etc.

config BR2_TARGET_ROOTFS_EXT4_TINY4412_INODES
	int "exact number of inodes (leave at 0 for auto calculation)"
	default 0

config BR2_TARGET_ROOTFS_EXT4_TINY4412_MKFS_OPTIONS
	string "options for make_ext4fs"
	default "-s -a root"

config BR2_TARGET_ROOTFS_EXT4_TINY4412_RESBLKS
	int "reserved blocks percentage"
	default 5
	help
	  The number of blocks on the filesystem (as a percentage of the
	  total number of blocks), that are reserved for use by root.
	  Traditionally, this has been 5%, and all ext-related tools still
	  default to reserving 5% when creating a new ext filesystem.

endif # BR2_TARGET_ROOTFS_EXT4_TINY4412
```

## package/arm-linux-bsp-tests/Config.in
```kconfig
menuconfig BR2_PACKAGE_ARM_LINUX_BSP_TESTS
	bool "arm-linux-bsp-test-case"
	help
		arm linux bsp test case

if BR2_PACKAGE_ARM_LINUX_BSP_TESTS

config BR2_PACKAGE_ARM_LINUX_BSP_TESTS_RPI
	bool "arm-linux-bsp-test-case for raspiberry"
	depends on BR2_PACKAGE_RPI_USERLAND
	help
		arm linux bsp test case for raspiberry

config BR2_PACKAGE_ARM_LINUX_BSP_TESTS_EXYNOS_4412
	bool "arm-linux-bsp-test-case for exynos 4412"
	help
		arm linux bsp test case for exynos 4412

endif
```

## package/es_common/Config.in
```kconfig
config BR2_PACKAGE_ES_COMMON
	bool "embedded system common lib"
	help
	  the embedded system common lib is porting from linux kernel
	  what could support efficent common data structure and stl in C
	  Language in Embeded system in all machine platform
```

## package/es_demo_cv_detect/Config.in
```kconfig
config BR2_PACKAGE_ES_DEMO_CV_DETECT
bool"es_demo_cv_detect"
help
  es_demo_cv_detect to show
```

## package/es_udk/Config.in
```kconfig
config BR2_PACKAGE_ES_UDK
	bool "embedded system unify development kit"
	select BR2_PACKAGE_FFMPEG
	select BR2_PACKAGE_FFMPEG_SWSCALE
	help

	  the embedded system unify development kit supply unify api for all 
	  kinds of devices and 3d-party opensource packages for application
	  develop
```

## package/linux-3rd-lib-tests/Config.in
```kconfig
config BR2_PACKAGE_LINUX_3RD_LIB_TESTS
	bool "linux-3rd-lib-tests"
	select BR2_PACKAGE_LIBGLIB2
	select BR2_PACKAGE_FFMPEG
	select BR2_PACKAGE_LIBV4L
	help
		linux 3rd lib test cases
```

## package/tiny4412-userland/Config.in
```kconfig
config BR2_PACKAGE_TINY4412_USERLAND
	bool "tiny4412-userland"
	depends on BR2_arm
	depends on BR2_INSTALL_LIBSTDCPP
	depends on BR2_TOOLCHAIN_HAS_THREADS
	depends on !BR2_STATIC_LIBS
	help
		tiny4412 rootfs userland prebuild files
		https://github.com/zczjx/tiny4412-userland

if BR2_PACKAGE_TINY4412_USERLAND


endif
```

## toolchain/toolchain-external/toolchain-external-linaro-aarch64-gcc4/Config.in
```kconfig
config BR2_TOOLCHAIN_EXTERNAL_LINARO_AARCH64_GCC4
	bool "Linaro aarch64-linux-gnu-gcc 4.9.4"
	depends on BR2_aarch64
	depends on BR2_HOSTARCH = "x86_64" || BR2_HOSTARCH = "x86"
	depends on !BR2_STATIC_LIBS
	select BR2_TOOLCHAIN_EXTERNAL_GLIBC
	select BR2_TOOLCHAIN_HAS_SSP
	select BR2_INSTALL_LIBSTDCPP
	select BR2_TOOLCHAIN_HAS_NATIVE_RPC
	select BR2_TOOLCHAIN_HEADERS_AT_LEAST_4_0
	select BR2_TOOLCHAIN_GCC_AT_LEAST_4_9
	select BR2_TOOLCHAIN_HAS_FORTRAN
	help
	  Toolchain for the AArch64 architecture, from
	  http://www.linaro.org/engineering/armv8/
```

## toolchain/toolchain-external/toolchain-external-linaro-arm-gcc4-eabi/Config.in
```kconfig
config BR2_TOOLCHAIN_EXTERNAL_LINARO_ARM_GCC4_EABI
	bool "Lianro arm-linux-gnueabi-gcc 4.9.4"
	depends on BR2_arm
	depends on BR2_HOSTARCH = "x86_64" || BR2_HOSTARCH = "x86"
	depends on BR2_ARM_EABI
	depends on !BR2_STATIC_LIBS
	select BR2_TOOLCHAIN_EXTERNAL_GLIBC
	select BR2_TOOLCHAIN_HAS_SSP
	select BR2_TOOLCHAIN_HAS_NATIVE_RPC
	select BR2_INSTALL_LIBSTDCPP
	select BR2_HOSTARCH_NEEDS_IA32_LIBS
	select BR2_TOOLCHAIN_HEADERS_AT_LEAST_4_0
	select BR2_TOOLCHAIN_GCC_AT_LEAST_4_9
	help
	  Linaro toolchain for the ARM architecture.
	  It uses gcc 4.9.4
```

## toolchain/toolchain-external/toolchain-external-linaro-arm-gcc5-eabi/Config.in
```kconfig
config BR2_TOOLCHAIN_EXTERNAL_LINARO_ARM_GCC5_EABI
	bool "Lianro arm-linux-gnueabi-gcc 5.5.0"
	depends on BR2_arm
	depends on BR2_HOSTARCH = "x86_64" || BR2_HOSTARCH = "x86"
	depends on BR2_ARM_EABI
	depends on !BR2_STATIC_LIBS
	select BR2_TOOLCHAIN_EXTERNAL_GLIBC
	select BR2_TOOLCHAIN_HAS_SSP
	select BR2_TOOLCHAIN_HAS_NATIVE_RPC
	select BR2_INSTALL_LIBSTDCPP
	select BR2_HOSTARCH_NEEDS_IA32_LIBS
	select BR2_TOOLCHAIN_HEADERS_AT_LEAST_4_0
	select BR2_TOOLCHAIN_GCC_AT_LEAST_5
	help
	  Linaro toolchain for the ARM architecture.
	  It uses gcc 5.5.0
```

## toolchain/toolchain-external/toolchain-external-linaro-arm-gcc6-eabi/Config.in
```kconfig
config BR2_TOOLCHAIN_EXTERNAL_LINARO_ARM_GCC6_EABI
	bool "Lianro arm-linux-gnueabi-gcc 6.4.1"
	depends on BR2_arm
	depends on BR2_HOSTARCH = "x86_64" || BR2_HOSTARCH = "x86"
	depends on BR2_ARM_EABI
	depends on !BR2_STATIC_LIBS
	select BR2_TOOLCHAIN_EXTERNAL_GLIBC
	select BR2_TOOLCHAIN_HAS_SSP
	select BR2_TOOLCHAIN_HAS_NATIVE_RPC
	select BR2_INSTALL_LIBSTDCPP
	select BR2_HOSTARCH_NEEDS_IA32_LIBS
	select BR2_TOOLCHAIN_HEADERS_AT_LEAST_4_6
	select BR2_TOOLCHAIN_GCC_AT_LEAST_6
	help
	  Linaro toolchain for the ARM architecture.
	  It uses gcc 6.4.1
```

## toolchain/toolchain-external/toolchain-external-linaro-armv8l-gcc4-eabihf/Config.in
```kconfig
config BR2_TOOLCHAIN_EXTERNAL_LINARO_ARMV8L_GCC4_EABIHF
	bool "Linaro armv8l-linux-gnueabihf-gcc 4.9.4"
	depends on BR2_arm
	depends on BR2_ARM_CPU_ARMV8A
	depends on BR2_HOSTARCH = "x86_64" || BR2_HOSTARCH = "x86"
	depends on BR2_ARM_EABIHF
	depends on !BR2_STATIC_LIBS
	select BR2_TOOLCHAIN_EXTERNAL_GLIBC
	select BR2_TOOLCHAIN_HAS_SSP
	select BR2_TOOLCHAIN_HAS_NATIVE_RPC
	select BR2_INSTALL_LIBSTDCPP
	select BR2_TOOLCHAIN_HEADERS_AT_LEAST_4_0
	select BR2_TOOLCHAIN_GCC_AT_LEAST_4_9
	select BR2_TOOLCHAIN_HAS_FORTRAN
	help
	  Linaro toolchain for the ARMv8 32bits architecture.
	  It uses gcc 4.9.4
```
